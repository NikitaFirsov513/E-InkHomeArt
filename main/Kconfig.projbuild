## main/Kconfig.projbuild
```kconfig
menu "E-InkHomeArt"
    config APP_ART
        bool "Art application: persistent picture and browser upload"
        default n
        help
            SoftAP and local image preparation/upload page, dedicated art
            partition, power-loss-safe storage, factory OTP four-gray display.
            Use sdkconfig.defaults.art and partitions.art.csv.

    config APP_ART_GRAY_TEST
        bool "Art four-gray panel verification"
        depends on !APP_ART
        default n
        help
            Separate stage-2 profile: factory OTP four-gray waveform, one
            calibration frame at boot, optional embedded ArtFrame, UART and
            touch reports. No partial updates, Flash writes or networking.

    config APP_DISPLAY_TOUCH_TEST
        bool "Display and touch assembly test"
        depends on !APP_ART_GRAY_TEST && !APP_ART
        default n
        help
            UC8179 screen, GT911 touch, UART0 and a timer-driven D6 heartbeat.
            No ADC, accelerometer, charger control, radio or PSRAM test.
            Use sdkconfig.defaults.display-touch for this assembly stage.

    config APP_LED_TEST
        bool "LED-only first assembly test"
        default y
        depends on !APP_DISPLAY_TOUCH_TEST && !APP_ART_GRAY_TEST && !APP_ART
        help
            Blink D6 on GPIO6 using a periodic timer (500 ms on / 500 ms off).
            No panel, touch,
            accelerometer, ADC, charger control or external PSRAM is started.
            Use sdkconfig.defaults.diagnostics for full board diagnostics.

    config DISPLAY_TOUCH_PARTIAL_TEST
        bool "Interactive OTP partial-update bench test"
        depends on APP_DISPLAY_TOUCH_TEST
        default y
        help
            Short bench session matching Good Display GDEY075T7 partial example.
            First update is full. Cleanup follows the configured partial budget
            after release and 1.2 seconds of quiet time. The vendor recommends 5.
            Short active bursts keep power on for at most five partials;
            idle/release powers off high voltages, retaining digital RAM.
            Requests are coalesced; BUSY must finish before the next update.
            Disable for the conservative full-only mode with a 180-second gap.

    config DISPLAY_TOUCH_SPI_MHZ
        int "Display/touch test SPI clock (MHz)"
        depends on APP_DISPLAY_TOUCH_TEST
        range 1 10
        default 8
        help
            The model-specific Good Display example uses 10 MHz. This bench
            starts at 8 MHz; lower to 4 or 1 if physical image corruption occurs.

    config DISPLAY_TOUCH_PARTIALS_BEFORE_CLEAN
        int "Partial updates before an idle full clean"
        depends on DISPLAY_TOUCH_PARTIAL_TEST
        range 5 100
        default 5
        help
            Good Display recommends a full clean after five partial updates.
            Larger values are experimental and increase residual image/ghosting.
            At the limit, drawing pauses until release and 1.2 seconds idle;
            touch reports, UART and the heartbeat continue. UART f forces a clean.

    config DISPLAY_TOUCH_TARGET_MS
        int "Partial test minimum start-to-start interval (milliseconds)"
        depends on DISPLAY_TOUCH_PARTIAL_TEST
        range 300 2000
        default 350
        help
            Includes transfer, BUSY and power-off time, instead of adding a pause
            after them. The controller is never refreshed while still BUSY.

    if !APP_LED_TEST
    config DIAG_MIN_REFRESH_SECONDS
        int "Minimum interval between full screen updates (seconds)"
        range 180 3600
        default 180
        help
            Good Display recommends at least 180 seconds between SPI full refreshes.
            Used by full-only diagnostics. Interactive partial bench instead follows
            the configured partial budget and an idle full clean.
    endif
endmenu
```
